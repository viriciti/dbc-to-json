VERSION "HIPBNYYYYYYYYYYYYYYYYYYYYYYYYYYYYYYYYYYYYY/4/%%%/4/'%**4YYY///"

NS_ :

BS_:

BU_:

BO_ 2566890271 CorrectMessage: 8 Vector__XXX
 SG_ CorrectSignal : 0|64@1- (1,0) [0|0] "" Vector__XXX

BO_ 2566890272 WrongMessage: 8 Vector__XXX
 SG_ ErrorSignal : 0|64@1- (1,0) [0|0] "" Vector__XXX

SIG_VALTYPE_ 2566890272 ErrorSignal : 2;
SIG_VALTYPE_ 2566890273 ErrorSignal : 2;
SIG_VALTYPE_ 2566890272 NotThere : 2;
